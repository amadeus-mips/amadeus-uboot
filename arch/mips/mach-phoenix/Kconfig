## arch/mips/mach-phoenix/Kconfig
```kconfig
menu "Phoenix CPU platforms"
    depends on MACH_PHOENIX

choice
    prompt "Board select"

config TARGET_PHOENIX_ARTIX7
    bool "artix 7"

endchoice

source "board/phoenix/artix7/Kconfig"

endmenu
```

## board/phoenix/artix7/Kconfig
```kconfig
if TARGET_PHOENIX_ARTIX7

config SYS_BOARD
    default "artix7"

config SYS_VENDOR
    default "phoenix"

config SYS_CONFIG_NAME
    default "phoenix_artix7"

config SYS_TEXT_BASE
    default 0x80000000

endif
```
